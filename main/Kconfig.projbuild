## main/Kconfig.projbuild
```kconfig
menu "C3DEV Configuration"
    menu "NTP Server Configuration"
        config C3DEV_NTP_SERVER1
            string "NTP Server1"
            default "ntp1.jst.mfeed.ad.jp"
        config C3DEV_NTP_SERVER2
            string "NTP Server2"
            default "ntp2.jst.mfeed.ad.jp"
        config C3DEV_NTP_SERVER3
            string "NTP Server3"
            default "ntp3.jst.mfeed.ad.jp"
    endmenu

    choice
        prompt "Select GPIO 18/19"
            default GPIO1819_NONE
        config GPIO1819_NONE
            bool "None"
        config GPIO1819_I2C
            bool "Connect I2C (UNIT ENV III, UltraSonic)"
        config GPIO1819_UART_UNITGPS
            bool "Connect UART (UNIT GPS)"
        config GPIO1819_DIGIT_UNITIR
            bool "Connect DIGITAL (UNIT IR)"
        config GPIO1819_IMU6886
            bool "Connect I2C (UNIT MPU6886)"
    endchoice
endmenu
```
